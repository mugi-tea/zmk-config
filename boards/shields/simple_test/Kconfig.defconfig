## boards/shields/simple_test/Kconfig.defconfig
```kconfig
if SHIELD_SIMPLE_TEST_LEFT

endif

if SHIELD_SIMPLE_TEST_RIGHT

config ZMK_KEYBOARD_NAME
    default "Simple Test"

config ZMK_SPLIT_ROLE_CENTRAL
    default y

config PMW3610
    default y

config INPUT
    default y

config ZMK_MOUSE
    default y

config ZMK_POINTING
    default y

endif

if SHIELD_SIMPLE_TEST_LEFT || SHIELD_SIMPLE_TEST_RIGHT

config ZMK_SPLIT
    default y

endif
```
